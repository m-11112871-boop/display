#include <SPI.h>
#include <Wire.h>
#include <Adafruit_GFX.h>
#include <Adafruit_SSD1306.h>
#include <Servo.h>
#include <SoftwareSerial.h>


#define SCREEN_WIDTH 128 
#define SCREEN_HEIGHT 64 
#define OLED_RESET     -1 
#define SCREEN_ADDRESS 0x3C 

// Camera TX -> D2
SoftwareSerial CameraSerial(2, 3);


Servo panServo;   // Servo for horizontal movement (Left/Right)  pin 9
Servo tiltServo;  // Servo for vertical movement (Up/Down)       pin 10


enum Expression {
  HAPPY,
  SAD,
  ANGRY,
  SURPRISED,
  NUM_EXPRESSIONS
};

// Simplified sub-states for the active idle loop
enum IdleState {
  IDLE_NORMAL_SMILE,
  IDLE_BLUSHING
};

Expression currentExpression = HAPPY; 
IdleState currentIdleState = IDLE_NORMAL_SMILE;

unsigned long nextBlinkTime = 0;
unsigned long blinkEndTime = 0;
bool isBlinking = false;

unsigned long nextIdleBehaviorTime = 0;

bool lastButtonState = HIGH;
unsigned long lastDebounceTime = 0;
const unsigned long DEBOUNCE_DELAY = 50; 

Adafruit_SSD1306 display(SCREEN_WIDTH, SCREEN_HEIGHT, &Wire, OLED_RESET);

// --- RESTORED ORIGINAL EYE BITMAPS (18x32 px) ---
const unsigned char PROGMEM eye_normal[] = {
  0x03, 0xfc, 0x00, 0x0f, 0xff, 0x00, 0x1f, 0xff, 0x80, 0x3f, 0xff, 0xc0, 
  0x7f, 0xff, 0xe0, 0x7f, 0xff, 0xe0, 0xff, 0xff, 0xf0, 0xff, 0xff, 0xf0, 
  0xff, 0xff, 0xf0, 0xff, 0xff, 0xf0, 0xff, 0xff, 0xf0, 0xff, 0xff, 0xf0, 
  0xff, 0xff, 0xf0, 0xff, 0xff, 0xf0, 0xff, 0xff, 0xf0, 0xff, 0xff, 0xf0, 
  0xff, 0xff, 0xf0, 0xff, 0xff, 0xf0, 0xff, 0xff, 0xf0, 0xff, 0xff, 0xf0, 
  0xff, 0xff, 0xf0, 0xff, 0xff, 0xf0, 0x7f, 0xff, 0xe0, 0x7f, 0xff, 0xe0, 
  0x3f, 0xff, 0xc0, 0x1f, 0xff, 0x80, 0x0f, 0xff, 0x00, 0x03, 0xfc, 0x00
};

const unsigned char PROGMEM eye_closed_left[] = {
  0xfe, 0x00, 0x00, 0xff, 0x80, 0x00, 0xff, 0xe0, 0x00, 0x3f, 0xf8, 0x00, 
  0x0f, 0xfe, 0x00, 0x03, 0xff, 0x80, 0x00, 0xff, 0xe0, 0x00, 0x7f, 0xf8, 
  0x00, 0x3f, 0xfe, 0x00, 0x1f, 0xff, 0x00, 0x1f, 0xff, 0x00, 0x3f, 0xfe, 
  0x00, 0xff, 0xf8, 0x01, 0xff, 0xf0, 0x03, 0xff, 0xe0, 0x07, 0xff, 0xc0, 
  0x0f, 0xff, 0x80, 0x0f, 0xff, 0x00, 0x0f, 0xfe, 0x00, 0x07, 0xfc, 0x00, 
  0x03, 0xf8, 0x00, 0x01, 0xf0, 0x00, 0x00, 0xe0, 0x00, 0x00, 0x40, 0x00, 
  0x00, 0x00, 0x00, 0x00, 0x00, 0x00, 0x00, 0x00, 0x00, 0x00, 0x00, 0x00
};


const unsigned char PROGMEM eye_closed_right[] = {
  0x00, 0x00, 0x7f, 0x00, 0x01, 0xff, 0x00, 0x07, 0xff, 0x00, 0x1f, 0xfc, 
  0x00, 0x7f, 0xf0, 0x01, 0xff, 0xc0, 0x07, 0xff, 0x00, 0x1f, 0xfe, 0x00, 
  0x7f, 0xfc, 0x00, 0xff, 0xf8, 0x00, 0xff, 0xf8, 0x00, 0x7f, 0xfc, 0x00, 
  0x1f, 0xff, 0x00, 0x0f, 0xff, 0x80, 0x07, 0xff, 0xc0, 0x03, 0xff, 0xe0, 
  0x01, 0xff, 0xf0, 0x00, 0xff, 0xf0, 0x00, 0x7f, 0xf0, 0x00, 0x3f, 0xe0, 
  0x00, 0x1f, 0xc0, 0x00, 0x0f, 0x80, 0x00, 0x07, 0x00, 0x00, 0x02, 0x00, 
  0x00, 0x00, 0x00, 0x00, 0x00, 0x00, 0x00, 0x00, 0x00, 0x00, 0x00, 0x00
};

// Left Eye - Open glare, slanting downwards to the inner right corner
const unsigned char PROGMEM eye_angry_left[] = {
  0x00, 0x00, 0x00, 0x00, 0x00, 0x00, 0x00, 0x00, 0x00, 0x00, 0x00, 0x00, 
  0x00, 0x00, 0x00, 0x00, 0x00, 0x00, 0x00, 0x00, 0x00, 0x00, 0x00, 0x00, 
  0x00, 0x00, 0x00, 0x00, 0x00, 0x00, 0x04, 0x00, 0x00, 0x0f, 0x00, 0x00, 
  0x0f, 0xe0, 0x00, 0x0f, 0xfc, 0x00, 0x0f, 0xc7, 0x00, 0x1f, 0x83, 0xe0, 
  0x0f, 0x83, 0xf8, 0x0f, 0x83, 0xf8, 0x0f, 0xc7, 0xf8, 0x0f, 0xff, 0xf8, 
  0x07, 0xff, 0xf0, 0x03, 0xff, 0xe0, 0x01, 0xff, 0xc0, 0x00, 0xff, 0x80, 
  0x00, 0x08, 0x00, 0x00, 0x00, 0x00, 0x00, 0x00, 0x00, 0x00, 0x00, 0x00
};

// Right Eye - Open glare, slanting downwards to the inner left corner
const unsigned char PROGMEM eye_angry_right[] = {
  0x00, 0x00, 0x00, 0x00, 0x00, 0x00, 0x00, 0x00, 0x00, 0x00, 0x00, 0x00, 
  0x00, 0x00, 0x00, 0x00, 0x00, 0x00, 0x00, 0x00, 0x00, 0x00, 0x00, 0x00, 
  0x00, 0x00, 0x00, 0x00, 0x00, 0x00, 0x00, 0x00, 0x30, 0x00, 0x00, 0xf8, 
  0x00, 0x07, 0xf8, 0x00, 0x3f, 0xf8, 0x00, 0xe3, 0xf8, 0x07, 0xc1, 0xfc, 
  0x0f, 0xc1, 0xf8, 0x0f, 0xc1, 0xf8, 0x0f, 0xe3, 0xf8, 0x0f, 0xff, 0xf8, 
  0x07, 0xff, 0xf0, 0x03, 0xff, 0xe0, 0x01, 0xff, 0xc0, 0x00, 0xff, 0x80, 
  0x00, 0x08, 0x00, 0x00, 0x00, 0x00, 0x00, 0x00, 0x00, 0x00, 0x00, 0x00
};


const unsigned char PROGMEM eye_sad_left[] = {
  0x00, 0x1c, 0x00, 0x00, 0x7f, 0x00, 0x00, 0xff, 0x80, 0x01, 0xff, 0xc0, 
  0x03, 0xff, 0xe0, 0x07, 0xff, 0xf0, 0x0f, 0xff, 0xf0, 0x1f, 0xff, 0xf0, 
  0x3f, 0xff, 0xf0, 0x7f, 0xff, 0xf0, 0xff, 0xff, 0xf0, 0xff, 0xff, 0xf0, 
  0xff, 0xff, 0xf0, 0xff, 0xff, 0xf0, 0xff, 0xff, 0xf0, 0xff, 0xff, 0xf0, 
  0xff, 0xff, 0xf0, 0xff, 0xff, 0xf0, 0xff, 0xff, 0xf0, 0xff, 0xff, 0xf0, 
  0xff, 0xff, 0xf0, 0xff, 0xff, 0xf0, 0x7f, 0xff, 0xe0, 0x7f, 0xff, 0xe0, 
  0x3f, 0xff, 0xc0, 0x1f, 0xff, 0x80, 0x0f, 0xff, 0x00, 0x03, 0xfc, 0x00
};

const unsigned char PROGMEM eye_sad_right[] = {
  0x03, 0x80, 0x00, 0x0f, 0xe0, 0x00, 0x1f, 0xf8, 0x00, 0x3f, 0xfc, 0x00, 
  0x7f, 0xfe, 0x00, 0xff, 0xff, 0x00, 0xff, 0xff, 0x80, 0xff, 0xff, 0xc0, 
  0xff, 0xff, 0xe0, 0xff, 0xff, 0xf0, 0xff, 0xff, 0xf0, 0xff, 0xff, 0xf0, 
  0xff, 0xff, 0xf0, 0xff, 0xff, 0xf0, 0xff, 0xff, 0xf0, 0xff, 0xff, 0xf0, 
  0xff, 0xff, 0xf0, 0xff, 0xff, 0xf0, 0xff, 0xff, 0xf0, 0xff, 0xff, 0xf0, 
  0xff, 0xff, 0xf0, 0xff, 0xff, 0xf0, 0x7f, 0xff, 0xe0, 0x7f, 0xff, 0xe0, 
  0x3f, 0xff, 0xc0, 0x1f, 0xff, 0x80, 0x0f, 0xff, 0x00, 0x03, 0xfc, 0x00
};

const unsigned char PROGMEM eye_surprised[] = {
  0x01, 0xf8, 0x00, 0x07, 0xfe, 0x00, 0x0f, 0xff, 0x00, 0x1f, 0xff, 0x80, 
  0x3f, 0xff, 0xc0, 0x3f, 0xff, 0xc0, 0x7f, 0xff, 0xe0, 0x7f, 0xff, 0xe0, 
  0x7f, 0xff, 0xe0, 0x7f, 0xff, 0xe0, 0x7f, 0xff, 0xe0, 0x7f, 0xff, 0xe0, 
  0x7f, 0xff, 0xe0, 0x7f, 0xff, 0xe0, 0x7f, 0xff, 0xe0, 0x7f, 0xff, 0xe0, 
  0x3f, 0xff, 0xc0, 0x3f, 0xff, 0xc0, 0x1f, 0xff, 0x80, 0x0f, 0xff, 0x00, 
  0x07, 0xfe, 0x00, 0x01, 0xf8, 0x00
};

// --- CLEAN BITMAP MOUTHS ---
// 1. Smile Mouth (28x12 px)
const unsigned char PROGMEM mouth_smile_large[] = {
  0xf0, 0x00, 0x0f, 0x00, 0xfc, 0x00, 0x3f, 0x00, 0xfe, 0x00, 0x7f, 0x00,
  0x3f, 0x80, 0xfc, 0x00, 0x1f, 0xc1, 0xf8, 0x00, 0x0f, 0xe3, 0xf0, 0x00,
  0x07, 0xff, 0xe0, 0x00, 0x03, 0xff, 0xc0, 0x00, 0x01, 0xff, 0x80, 0x00,
  0x00, 0xff, 0x00, 0x00, 0x00, 0x7e, 0x00, 0x00, 0x00, 0x3c, 0x00, 0x00
};

// 2. Sad Mouth (28x12 px)
const unsigned char PROGMEM mouth_sad_large[] = {
  0x00, 0x3c, 0x00, 0x00, 0x00, 0x7e, 0x00, 0x00, 0x00, 0xff, 0x00, 0x00,
  0x01, 0xff, 0x80, 0x00, 0x03, 0xff, 0xc0, 0x00, 0x07, 0xff, 0xe0, 0x00,
  0x0f, 0xe3, 0xf0, 0x00, 0x1f, 0xc1, 0xf8, 0x00, 0x3f, 0x80, 0xfc, 0x00,
  0xfe, 0x00, 0x7f, 0x00, 0xfc, 0x00, 0x3f, 0x00, 0xf0, 0x00, 0x0f, 0x00
};

// 3. Surprised Mouth (16x16 px)
const unsigned char PROGMEM mouth_open_large[] = {
  0x07, 0xe0, 0x1f, 0xf8, 0x3f, 0xfc, 0x7f, 0xfe, 0x7c, 0x3e, 0xf8, 0x1f,
  0xf8, 0x1f, 0xf8, 0x1f, 0xf8, 0x1f, 0xf8, 0x1f, 0xf8, 0x1f, 0x7c, 0x3e,
  0x7f, 0xfe, 0x3f, 0xfc, 0x1f, 0xf8, 0x07, 0xe0
};


// ----------------------
// Servo Settings
// ----------------------

const int PAN_CENTER = 0;
const int TILT_CENTER = 0;

const int PAN_LEFT = -20;
const int PAN_RIGHT = 20;

const int TILT_UP = -20;
const int TILT_DOWN = 20;


// ----------------------------
// Reminder System
// ----------------------------

// ===== Variables =====
const unsigned long REMINDER_INTERVAL = 30000;   // every 30 seconds
const unsigned long REMINDER_DURATION = 5000;    // show for 5 seconds

String reminders[] =
{
  "Take a break?",
  "Sip time!",
  "Let's do this!"
};

const int totalReminders = sizeof(reminders) / sizeof(reminders[0]);

int reminderIndex = 0;

bool showingReminder = false;

unsigned long lastReminderTime = 0;
unsigned long reminderStartTime = 0;



void setup() {
  Serial.begin(9600);
  CameraSerial.begin(9600); 

  if(!display.begin(SSD1306_SWITCHCAPVCC, SCREEN_ADDRESS)) {
    Serial.println(F("SSD1306 allocation failed"));
    for(;;); 
  }
  display.begin(SSD1306_SWITCHCAPVCC, SCREEN_ADDRESS);
  display.setTextColor(SSD1306_WHITE);
  display.setTextWrap(false);

  display.clearDisplay();
  display.display();
  
  randomSeed(analogRead(A0));
  
  nextBlinkTime = millis() + random(2000, 4000);
  nextIdleBehaviorTime = millis() + random(3000, 6000);


  //  Setting up Servos
  panServo.attach(9);   // Connect Pan servo to Pin 9
  tiltServo.attach(10);  // Connect Tilt servo to Pin 10
  

  // panServo.write(PAN_CENTER);
  // tiltServo.write(TILT_CENTER);

  // // Shake 3 times
  // for (int i = 0; i < 2; i++)
  // {
  //   panServo.write(LEFT);
  //   delay(180);

  //   panServo.write(RIGHT);
  //   delay(180);
  // }

  // // Return to center
  // panServo.write(CENTER);
  // delay(150);

  // panServo.write(PAN_CENTER);
  // delay(200);

  // Excited spinning movement
    //Look left + tilt up
    panServo.write(-20);
    tiltServo.write(-20);
    // delay(200);


    // Look right + tilt down
    // panServo.write(PAN_RIGHT);
    // tiltServo.write(TILT_DOWN);
    // delay(200);


  // Happy little wiggle
  // for (int i = 0; i < 4; i++)
  // {
  //   panServo.write(-15);
  //   tiltServo.write(-10);
  //   delay(120);

  //   panServo.write(15);
  //   tiltServo.write(10);
  //   delay(120);
  // }


  // Return to normal
  panServo.write(PAN_CENTER);
  tiltServo.write(TILT_CENTER);
}



void manageBlinkTimer() {
  unsigned long currentTime = millis();

  if (!isBlinking && currentTime >= nextBlinkTime) {
    isBlinking = true;
    blinkEndTime = currentTime + 130; 
  } 
  else if (isBlinking && currentTime >= blinkEndTime) {
    isBlinking = false;
    nextBlinkTime = currentTime + random(3000, 6000); 
  }
}


void manageIdleAnimations() {
  if (currentExpression != HAPPY) return;

  unsigned long currentTime = millis();

  if (currentTime >= nextIdleBehaviorTime) {
    // Alternates strictly between Normal Smile (0) and Blushing (1)
    int randPick = random(0, 2);
    currentIdleState = (IdleState)randPick;
    nextIdleBehaviorTime = currentTime + random(3000, 6000);
  }
}


void renderCurrentFace() {
  display.clearDisplay();

  // 1. DRAW EYES
  if (isBlinking) {
    display.fillRect(22, 26, 18, 4, SSD1306_WHITE);
    display.fillRect(88, 26, 18, 4, SSD1306_WHITE);
  } 
  else {
    switch (currentExpression) {
      case HAPPY:
        display.drawBitmap(22, 12, eye_normal, 18, 32, SSD1306_WHITE);
        display.drawBitmap(88, 12, eye_normal, 18, 32, SSD1306_WHITE);
        break;

      case SAD:
        display.drawBitmap(22, 12, eye_sad_left, 18, 32, SSD1306_WHITE);
        display.drawBitmap(88, 12, eye_sad_right, 18, 32, SSD1306_WHITE);
        break;

      case ANGRY:
        display.drawBitmap(22, 12, eye_angry_left, 18, 32, SSD1306_WHITE);
        display.drawBitmap(88, 12, eye_angry_right, 18, 32, SSD1306_WHITE);
        break;

      case SURPRISED:
        display.drawBitmap(19, 16, eye_surprised, 24, 24, SSD1306_WHITE);
        display.drawBitmap(85, 16, eye_surprised, 24, 24, SSD1306_WHITE); 
        break;
    }
  }

  // 2. DRAW IDLE BLUSH LINES
  if (currentExpression == HAPPY && currentIdleState == IDLE_BLUSHING && !isBlinking) {
    display.drawFastHLine(12, 46, 6, SSD1306_WHITE);
    display.drawFastHLine(14, 49, 6, SSD1306_WHITE);
    display.drawFastHLine(110, 46, 6, SSD1306_WHITE);
    display.drawFastHLine(108, 49, 6, SSD1306_WHITE);
  }

  // 3. DRAW MOUTHS
  switch (currentExpression) {
    case HAPPY:
    case ANGRY:
      display.drawBitmap(50, 34, mouth_smile_large, 28, 12, SSD1306_WHITE);
      break;

    case SAD:
      display.drawBitmap(50, 36, mouth_sad_large, 28, 12, SSD1306_WHITE);
      break;

    case SURPRISED:
      display.drawBitmap(56, 34, mouth_open_large, 16, 16, SSD1306_WHITE);
      break;
  }

  display.display();
}


void startReminder()
{
  showingReminder = true;
  reminderStartTime = millis();

  Serial.print("Showing: ");
  Serial.println(reminders[reminderIndex]);
}

void manageReminder()
{
  if (!showingReminder) return;

  if (millis() - reminderStartTime >= REMINDER_DURATION)
  {
    showingReminder = false;

    reminderIndex++;

    if (reminderIndex >= totalReminders)
      reminderIndex = 0;
  }
}

void manageReminderTimer()
{
  if (showingReminder) return;

  if (millis() - lastReminderTime >= REMINDER_INTERVAL)
  {
    lastReminderTime = millis();
    startReminder();
  }
}


void renderReminder()
{
  display.clearDisplay();
  display.setTextColor(SSD1306_WHITE);
  display.setTextSize(2);

  switch (reminderIndex)
  {
    case 0:
      display.setCursor(5,15);
      display.println("Take a");
      display.setCursor(5,38);
      display.println("break?");
      break;

    case 1:
      display.setCursor(8,25);
      display.println("Sip time!");
      break;

    case 2:
      display.setCursor(5,15);
      display.println("Let's");
      display.setCursor(5,38);
      display.println("do this!");
      break;
  }

  display.display();
}

void loop()
{
  manageBlinkTimer();
  manageIdleAnimations();

  manageReminderTimer();
  manageReminder();

  if (showingReminder)
  {
    renderReminder();
  }else{

    renderCurrentFace();
  }

  if (CameraSerial.available()) {
    String msg = CameraSerial.readStringUntil('\n');
    Serial.println(msg);

    if (msg == "PERSON") {
      // Do something
    }
  }
}