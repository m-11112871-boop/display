#include <SPI.h>
#include <Wire.h>
#include <Adafruit_GFX.h>
#include <Adafruit_SSD1306.h>

#define SCREEN_WIDTH 128 
#define SCREEN_HEIGHT 64 
#define OLED_RESET     -1 
#define SCREEN_ADDRESS 0x3C 

const int BUTTON_PIN = 2;

enum Expression {
  HAPPY,
  SAD,
  ANGRY,
  SURPRISED,
  NUM_EXPRESSIONS
};

// Simplified sub-states for the active idle loop
enum IdleState {
  IDLE_NORMAL_SMILE,
  IDLE_BLUSHING
};

Expression currentExpression = HAPPY; 
IdleState currentIdleState = IDLE_NORMAL_SMILE;

unsigned long nextBlinkTime = 0;
unsigned long blinkEndTime = 0;
bool isBlinking = false;

unsigned long nextIdleBehaviorTime = 0;

bool lastButtonState = HIGH;
unsigned long lastDebounceTime = 0;
const unsigned long DEBOUNCE_DELAY = 50; 

Adafruit_SSD1306 display(SCREEN_WIDTH, SCREEN_HEIGHT, &Wire, OLED_RESET);

// --- RESTORED ORIGINAL EYE BITMAPS (18x32 px) ---
const unsigned char PROGMEM eye_normal[] = {
  0x03, 0xfc, 0x00, 0x0f, 0xff, 0x00, 0x1f, 0xff, 0x80, 0x3f, 0xff, 0xc0, 
  0x7f, 0xff, 0xe0, 0x7f, 0xff, 0xe0, 0xff, 0xff, 0xf0, 0xff, 0xff, 0xf0, 
  0xff, 0xff, 0xf0, 0xff, 0xff, 0xf0, 0xff, 0xff, 0xf0, 0xff, 0xff, 0xf0, 
  0xff, 0xff, 0xf0, 0xff, 0xff, 0xf0, 0xff, 0xff, 0xf0, 0xff, 0xff, 0xf0, 
  0xff, 0xff, 0xf0, 0xff, 0xff, 0xf0, 0xff, 0xff, 0xf0, 0xff, 0xff, 0xf0, 
  0xff, 0xff, 0xf0, 0xff, 0xff, 0xf0, 0x7f, 0xff, 0xe0, 0x7f, 0xff, 0xe0, 
  0x3f, 0xff, 0xc0, 0x1f, 0xff, 0x80, 0x0f, 0xff, 0x00, 0x03, 0xfc, 0x00
};

const unsigned char PROGMEM eye_angry_left[] = {
  0x00, 0x00, 0x00, 0x00, 0x0c, 0x00, 0x00, 0x3f, 0x00, 0x00, 0xff, 0x00, 
  0x03, 0xff, 0x80, 0x0f, 0xff, 0xc0, 0x1f, 0xff, 0xe0, 0x3f, 0xff, 0xf0, 
  0x7f, 0xff, 0xf0, 0xff, 0xff, 0xf0, 0xff, 0xff, 0xf0, 0xff, 0xff, 0xf0, 
  0xff, 0xff, 0xf0, 0xff, 0xff, 0xf0, 0xff, 0xff, 0xf0, 0xff, 0xff, 0xf0, 
  0xff, 0xff, 0xf0, 0xff, 0xff, 0xf0, 0xff, 0xff, 0xf0, 0xff, 0xff, 0xf0, 
  0xff, 0xff, 0xf0, 0xff, 0xff, 0xf0, 0x7f, 0xff, 0xe0, 0x7f, 0xff, 0xe0, 
  0x3f, 0xff, 0xc0, 0x1f, 0xff, 0x80, 0x0f, 0xff, 0x00, 0x03, 0xfc, 0x00
};

const unsigned char PROGMEM eye_angry_right[] = {
  0x00, 0x00, 0x00, 0x00, 0x30, 0x00, 0x00, 0xfc, 0x00, 0x03, 0xfc, 0x00, 
  0x0f, 0xfc, 0x00, 0x3f, 0xfc, 0x00, 0x7f, 0xfc, 0x00, 0xff, 0xfc, 0x00, 
  0xff, 0xfe, 0x00, 0xff, 0xff, 0x00, 0xff, 0xff, 0x80, 0xff, 0xff, 0xc0, 
  0xff, 0xff, 0xf0, 0xff, 0xff, 0xf0, 0xff, 0xff, 0xf0, 0xff, 0xff, 0xf0, 
  0xff, 0xff, 0xf0, 0xff, 0xff, 0xf0, 0xff, 0xff, 0xf0, 0xff, 0xff, 0xf0, 
  0xff, 0xff, 0xf0, 0xff, 0xff, 0xf0, 0x7f, 0xff, 0xe0, 0x7f, 0xff, 0xe0, 
  0x3f, 0xff, 0xc0, 0x1f, 0xff, 0x80, 0x0f, 0xff, 0x00, 0x03, 0xfc, 0x00
};

const unsigned char PROGMEM eye_sad_left[] = {
  0x00, 0x1c, 0x00, 0x00, 0x7f, 0x00, 0x00, 0xff, 0x80, 0x01, 0xff, 0xc0, 
  0x03, 0xff, 0xe0, 0x07, 0xff, 0xf0, 0x0f, 0xff, 0xf0, 0x1f, 0xff, 0xf0, 
  0x3f, 0xff, 0xf0, 0x7f, 0xff, 0xf0, 0xff, 0xff, 0xf0, 0xff, 0xff, 0xf0, 
  0xff, 0xff, 0xf0, 0xff, 0xff, 0xf0, 0xff, 0xff, 0xf0, 0xff, 0xff, 0xf0, 
  0xff, 0xff, 0xf0, 0xff, 0xff, 0xf0, 0xff, 0xff, 0xf0, 0xff, 0xff, 0xf0, 
  0xff, 0xff, 0xf0, 0xff, 0xff, 0xf0, 0x7f, 0xff, 0xe0, 0x7f, 0xff, 0xe0, 
  0x3f, 0xff, 0xc0, 0x1f, 0xff, 0x80, 0x0f, 0xff, 0x00, 0x03, 0xfc, 0x00
};

const unsigned char PROGMEM eye_sad_right[] = {
  0x03, 0x80, 0x00, 0x0f, 0xe0, 0x00, 0x1f, 0xf8, 0x00, 0x3f, 0xfc, 0x00, 
  0x7f, 0xfe, 0x00, 0xff, 0xff, 0x00, 0xff, 0xff, 0x80, 0xff, 0xff, 0xc0, 
  0xff, 0xff, 0xe0, 0xff, 0xff, 0xf0, 0xff, 0xff, 0xf0, 0xff, 0xff, 0xf0, 
  0xff, 0xff, 0xf0, 0xff, 0xff, 0xf0, 0xff, 0xff, 0xf0, 0xff, 0xff, 0xf0, 
  0xff, 0xff, 0xf0, 0xff, 0xff, 0xf0, 0xff, 0xff, 0xf0, 0xff, 0xff, 0xf0, 
  0xff, 0xff, 0xf0, 0xff, 0xff, 0xf0, 0x7f, 0xff, 0xe0, 0x7f, 0xff, 0xe0, 
  0x3f, 0xff, 0xc0, 0x1f, 0xff, 0x80, 0x0f, 0xff, 0x00, 0x03, 0xfc, 0x00
};

const unsigned char PROGMEM eye_surprised[] = {
  0x01, 0xf8, 0x00, 0x07, 0xfe, 0x00, 0x0f, 0xff, 0x00, 0x1f, 0xff, 0x80, 
  0x3f, 0xff, 0xc0, 0x3f, 0xff, 0xc0, 0x7f, 0xff, 0xe0, 0x7f, 0xff, 0xe0, 
  0x7f, 0xff, 0xe0, 0x7f, 0xff, 0xe0, 0x7f, 0xff, 0xe0, 0x7f, 0xff, 0xe0, 
  0x7f, 0xff, 0xe0, 0x7f, 0xff, 0xe0, 0x7f, 0xff, 0xe0, 0x7f, 0xff, 0xe0, 
  0x3f, 0xff, 0xc0, 0x3f, 0xff, 0xc0, 0x1f, 0xff, 0x80, 0x0f, 0xff, 0x00, 
  0x07, 0xfe, 0x00, 0x01, 0xf8, 0x00
};

// --- CLEAN BITMAP MOUTHS ---
// 1. Smile Mouth (28x12 px)
const unsigned char PROGMEM mouth_smile_large[] = {
  0xf0, 0x00, 0x0f, 0x00, 0xfc, 0x00, 0x3f, 0x00, 0xfe, 0x00, 0x7f, 0x00,
  0x3f, 0x80, 0xfc, 0x00, 0x1f, 0xc1, 0xf8, 0x00, 0x0f, 0xe3, 0xf0, 0x00,
  0x07, 0xff, 0xe0, 0x00, 0x03, 0xff, 0xc0, 0x00, 0x01, 0xff, 0x80, 0x00,
  0x00, 0xff, 0x00, 0x00, 0x00, 0x7e, 0x00, 0x00, 0x00, 0x3c, 0x00, 0x00
};

// 2. Sad Mouth (28x12 px)
const unsigned char PROGMEM mouth_sad_large[] = {
  0x00, 0x3c, 0x00, 0x00, 0x00, 0x7e, 0x00, 0x00, 0x00, 0xff, 0x00, 0x00,
  0x01, 0xff, 0x80, 0x00, 0x03, 0xff, 0xc0, 0x00, 0x07, 0xff, 0xe0, 0x00,
  0x0f, 0xe3, 0xf0, 0x00, 0x1f, 0xc1, 0xf8, 0x00, 0x3f, 0x80, 0xfc, 0x00,
  0xfe, 0x00, 0x7f, 0x00, 0xfc, 0x00, 0x3f, 0x00, 0xf0, 0x00, 0x0f, 0x00
};

// 3. Surprised Mouth (16x16 px)
const unsigned char PROGMEM mouth_open_large[] = {
  0x07, 0xe0, 0x1f, 0xf8, 0x3f, 0xfc, 0x7f, 0xfe, 0x7c, 0x3e, 0xf8, 0x1f,
  0xf8, 0x1f, 0xf8, 0x1f, 0xf8, 0x1f, 0xf8, 0x1f, 0xf8, 0x1f, 0x7c, 0x3e,
  0x7f, 0xfe, 0x3f, 0xfc, 0x1f, 0xf8, 0x07, 0xe0
};


void setup() {
  Serial.begin(9600);
  pinMode(BUTTON_PIN, INPUT_PULLUP);

  if(!display.begin(SSD1306_SWITCHCAPVCC, SCREEN_ADDRESS)) {
    Serial.println(F("SSD1306 allocation failed"));
    for(;;); 
  }

  display.clearDisplay();
  display.display();
  
  randomSeed(analogRead(A0));
  
  nextBlinkTime = millis() + random(2000, 4000);
  nextIdleBehaviorTime = millis() + random(3000, 6000);
}


void loop() {
  checkButton();
  manageBlinkTimer();
  manageIdleAnimations();
  renderCurrentFace();
}


void checkButton() {
  int reading = digitalRead(BUTTON_PIN);

  if (reading != lastButtonState) {
    lastDebounceTime = millis();
  }

  if ((millis() - lastDebounceTime) > DEBOUNCE_DELAY) {
    if (reading == LOW && !isBlinking) { 
      int nextState = (int)currentExpression + 1;
      if (nextState >= NUM_EXPRESSIONS) nextState = 0;
      
      currentExpression = (Expression)nextState;
      currentIdleState = IDLE_NORMAL_SMILE;
      nextIdleBehaviorTime = millis() + random(3000, 6000);
      
      delay(250); 
    }
  }
  lastButtonState = reading;
}


void manageBlinkTimer() {
  unsigned long currentTime = millis();

  if (!isBlinking && currentTime >= nextBlinkTime) {
    isBlinking = true;
    blinkEndTime = currentTime + 130; 
  } 
  else if (isBlinking && currentTime >= blinkEndTime) {
    isBlinking = false;
    nextBlinkTime = currentTime + random(3000, 6000); 
  }
}


void manageIdleAnimations() {
  if (currentExpression != HAPPY) return;

  unsigned long currentTime = millis();

  if (currentTime >= nextIdleBehaviorTime) {
    // Alternates strictly between Normal Smile (0) and Blushing (1)
    int randPick = random(0, 2);
    currentIdleState = (IdleState)randPick;
    nextIdleBehaviorTime = currentTime + random(3000, 6000);
  }
}


void renderCurrentFace() {
  display.clearDisplay();

  // 1. DRAW EYES
  if (isBlinking) {
    display.fillRect(22, 26, 18, 4, SSD1306_WHITE);
    display.fillRect(88, 26, 18, 4, SSD1306_WHITE);
  } 
  else {
    switch (currentExpression) {
      case HAPPY:
        display.drawBitmap(22, 12, eye_normal, 18, 32, SSD1306_WHITE);
        display.drawBitmap(88, 12, eye_normal, 18, 32, SSD1306_WHITE);
        break;

      case SAD:
        display.drawBitmap(22, 12, eye_sad_left, 18, 32, SSD1306_WHITE);
        display.drawBitmap(88, 12, eye_sad_right, 18, 32, SSD1306_WHITE);
        break;

      case ANGRY:
        display.drawBitmap(22, 12, eye_angry_left, 18, 32, SSD1306_WHITE);
        display.drawBitmap(88, 12, eye_angry_right, 18, 32, SSD1306_WHITE);
        break;

      case SURPRISED:
        display.drawBitmap(19, 16, eye_surprised, 24, 24, SSD1306_WHITE);
        display.drawBitmap(85, 16, eye_surprised, 24, 24, SSD1306_WHITE);
        break;
    }
  }

  // 2. DRAW IDLE BLUSH LINES
  if (currentExpression == HAPPY && currentIdleState == IDLE_BLUSHING && !isBlinking) {
    display.drawFastHLine(12, 46, 6, SSD1306_WHITE);
    display.drawFastHLine(14, 49, 6, SSD1306_WHITE);
    display.drawFastHLine(110, 46, 6, SSD1306_WHITE);
    display.drawFastHLine(108, 49, 6, SSD1306_WHITE);
  }

  // 3. DRAW MOUTHS
  switch (currentExpression) {
    case HAPPY:
    case ANGRY:
      display.drawBitmap(50, 34, mouth_smile_large, 28, 12, SSD1306_WHITE);
      break;

    case SAD:
      display.drawBitmap(50, 36, mouth_sad_large, 28, 12, SSD1306_WHITE);
      break;

    case SURPRISED:
      display.drawBitmap(56, 34, mouth_open_large, 16, 16, SSD1306_WHITE);
      break;
  }

  display.display();
}
